## Documentation/devicetree/bindings/power/supply/siliconmitus,sm5440.yaml
```yaml
# SPDX-License-Identifier: (GPL-2.0-only OR BSD-2-Clause)
%YAML 1.2
---
$id: http://devicetree.org/schemas/power/supply/siliconmitus,sm5440.yaml#
$schema: http://devicetree.org/meta-schemas/core.yaml#

title: Silicon Mitus SM5440 switched-capacitor charge pump

maintainers:
  - Omar Fityan <me@omarfityan.com>

description:
  The Silicon Mitus SM5440 is an inductorless switched-capacitor (2:1) charge
  pump used on the cell side of a USB Power Delivery / PPS direct-charge path.
  It is controlled over I2C and reports input voltage, input current and die
  temperature through an on-chip ADC.

properties:
  compatible:
    const: siliconmitus,sm5440

  reg:
    maxItems: 1

required:
  - compatible
  - reg

additionalProperties: false

examples:
  - |
    i2c {
        #address-cells = <1>;
        #size-cells = <0>;

        charger@63 {
            compatible = "siliconmitus,sm5440";
            reg = <0x63>;
        };
    };
...
```

## Documentation/devicetree/bindings/power/supply/siliconmitus,sm5714-fuelgauge.yaml
```yaml
# SPDX-License-Identifier: (GPL-2.0-only OR BSD-2-Clause)
%YAML 1.2
---
$id: http://devicetree.org/schemas/power/supply/siliconmitus,sm5714-fuelgauge.yaml#
$schema: http://devicetree.org/meta-schemas/core.yaml#

title: Silicon Mitus SM5714 fuel gauge

maintainers:
  - Omar Fityan <me@omarfityan.com>

description:
  The fuel-gauge sub-block of the Silicon Mitus SM5714 power-management IC,
  accessed as an independent I2C client at its own address. It reports battery
  capacity, voltage, current and temperature as a POWER_SUPPLY_TYPE_BATTERY.
  The gauge is cell-powered and keeps its vendor-programmed model across
  resets, so no model data is passed through the device tree.

properties:
  compatible:
    const: siliconmitus,sm5714-fuelgauge

  reg:
    maxItems: 1

required:
  - compatible
  - reg

additionalProperties: false

examples:
  - |
    i2c {
        #address-cells = <1>;
        #size-cells = <0>;

        fuel-gauge@71 {
            compatible = "siliconmitus,sm5714-fuelgauge";
            reg = <0x71>;
        };
    };
...
```

## Documentation/devicetree/bindings/power/supply/siliconmitus,sm5714-usb-vbus.yaml
```yaml
# SPDX-License-Identifier: (GPL-2.0-only OR BSD-2-Clause)
%YAML 1.2
---
$id: http://devicetree.org/schemas/power/supply/siliconmitus,sm5714-usb-vbus.yaml#
$schema: http://devicetree.org/meta-schemas/core.yaml#

title: Silicon Mitus SM5714 USB VBUS / battery charger

maintainers:
  - Omar Fityan <me@omarfityan.com>

description:
  The charger / USB-VBUS sub-block of the Silicon Mitus SM5714 power-management
  IC, accessed as an independent I2C client at its own address. It manages the
  battery charge FET and the input voltage/current limits, sources VBUS for USB
  host (OTG) mode, and gates charging on a cell-temperature NTC read from an
  external ADC channel.

properties:
  compatible:
    const: siliconmitus,sm5714-usb-vbus

  reg:
    maxItems: 1

  io-channels:
    maxItems: 1
    description:
      Cell-temperature NTC thermistor channel on an external ADC, used by the
      charge thermal gate.

  io-channel-names:
    items:
      - const: batt-therm

  siliconmitus,vbus-always-on:
    type: boolean
    description:
      Bring USB host VBUS sourcing up at boot instead of on demand. The SM5714
      cannot source VBUS and charge the battery at the same time, so setting
      this prevents battery charging while host VBUS is enabled.

required:
  - compatible
  - reg
  - io-channels
  - io-channel-names

additionalProperties: false

examples:
  - |
    i2c {
        #address-cells = <1>;
        #size-cells = <0>;

        charger@49 {
            compatible = "siliconmitus,sm5714-usb-vbus";
            reg = <0x49>;
            io-channels = <&pmic_adc 0>;
            io-channel-names = "batt-therm";
        };
    };
...
```

## Documentation/devicetree/bindings/usb/siliconmitus,sm5714-typec.yaml
```yaml
# SPDX-License-Identifier: (GPL-2.0-only OR BSD-2-Clause)
%YAML 1.2
---
$id: http://devicetree.org/schemas/usb/siliconmitus,sm5714-typec.yaml#
$schema: http://devicetree.org/meta-schemas/core.yaml#

title: Silicon Mitus SM5714 USB Type-C / PD controller (PDIC)

maintainers:
  - Omar Fityan <me@omarfityan.com>

description:
  The USB Type-C cable-orientation and role-detect block (PDIC) of the Silicon
  Mitus SM5714, accessed as an independent I2C client at its own address. It
  performs autonomous DRP role detection, drives the USB role switch and the
  SM5714 OTG VBUS, and carries USB Power Delivery messaging through the chip's
  hardware PD protocol layer.

properties:
  compatible:
    const: siliconmitus,sm5714-typec

  reg:
    maxItems: 1

  interrupts:
    maxItems: 1

  connector:
    type: object
    $ref: ../connector/usb-connector.yaml#
    unevaluatedProperties: false
    description:
      Properties for the USB Type-C connector.

required:
  - compatible
  - reg
  - interrupts
  - connector

additionalProperties: false

examples:
  - |
    #include <dt-bindings/interrupt-controller/irq.h>

    i2c {
        #address-cells = <1>;
        #size-cells = <0>;

        usbpd@33 {
            compatible = "siliconmitus,sm5714-typec";
            reg = <0x33>;
            interrupt-parent = <&tlmm>;
            interrupts = <133 IRQ_TYPE_LEVEL_LOW>;

            connector {
                compatible = "usb-c-connector";
                label = "USB-C";
                power-role = "dual";
                data-role = "dual";
                try-power-role = "sink";

                port {
                    endpoint {
                        remote-endpoint = <&usb_dwc3_hs>;
                    };
                };
            };
        };
    };
...
```

## drivers/input/sec_input/Kconfig
```kconfig
# SPDX-License-Identifier: GPL-2.0
#
# Samsung sec_input keyboard-cover drivers (ubuntu-tab port)
#

config KEYBOARD_STM32_POGO_V3
	tristate "Samsung STM32 POGO keyboard cover (V3)"
	depends on I2C
	select INPUT_MATRIXKMAP
	help
	  Support for the Samsung Book Cover Keyboard used by the Galaxy Tab S9
	  Ultra (SM-X910). The cover is an STM32 microcontroller on the pogo-pin
	  connector, attached over I2C (stm,stm32_pogo, address 0x2a). This is a
	  port of Samsung's downstream stm32_pogo_v3 driver bundle; it reports a
	  matrix keypad and (optionally) a touchpad, and drives the MAX77816
	  buck-boost booster rail for high-current cover models.

	  Say M here to build it as a module, or Y to build it in. If unsure, N.
```

## drivers/usb/typec/sm5714/Kconfig
```kconfig
# SPDX-License-Identifier: GPL-2.0
config TYPEC_SM5714
	tristate "Silicon Mitus SM5714 Type-C Port Controller"
	depends on I2C
	depends on TYPEC_TCPM
	help
	  A USB Type-C Port Controller (tcpc_dev) driver for the Silicon Mitus
	  SM5714 PMIC's autonomous Type-C/PD controller (PDIC), binding it to the
	  kernel's USB-PD policy engine (tcpm).  The SM5714 has a vendor register
	  layout rather than a standard TCPCI block, so it is integrated the way
	  Qualcomm's PMIC Type-C is: this driver provides the CC/role/PD-FIFO
	  transport and feeds tcpm's state machine from the chip interrupt.

	  Say Y or M here to use USB-PD on boards with the SM5714 (e.g. the
	  Samsung Galaxy Tab S9 Ultra, SM-X910).
```
